## config/boards/shields/KobitoKey/Kconfig.shield
```kconfig
config SHIELD_KOBITOKEY_LEFT
    def_bool $(shields_list_contains,KobitoKey_left)

config SHIELD_KOBITOKEY_RIGHT
    def_bool $(shields_list_contains,KobitoKey_right)

config KOBITOKEY_IDLE_RETURN_WATCH_LAYER
    int "Layer watched by the idle layer return (typing layer)"
    default 1

config KOBITOKEY_IDLE_RETURN_HOME_LAYER
    int "Layer to return to after the idle timeout (home layer)"
    default 0

config KOBITOKEY_IDLE_RETURN_TIMEOUT_MS
    int "Idle timeout before returning to the home layer (ms)"
    default 30000
```

## config/boards/shields/KobitoKey/dts/bindings/behaviors/zmk,behavior-arcane.yaml
```yaml
# Copyright (c) 2026 kiyo
# SPDX-License-Identifier: MIT

description: Arcane key behavior (repeat/magic hybrid)

compatible: "zmk,behavior-arcane"

include: one_param.yaml

properties:
  usage-pages:
    type: array
    required: true
```

## config/boards/shields/KobitoKey/dts/bindings/behaviors/zmk,behavior-jis-toggle.yaml
```yaml
# Copyright (c) 2026 kiyo
# SPDX-License-Identifier: MIT

description: JIS/US output mode toggle behavior

compatible: "zmk,behavior-jis-toggle"

include: one_param.yaml
```

## config/west.yml
```yaml
manifest:
  remotes:
    - name: zmkfirmware
      url-base: https://github.com/zmkfirmware
    - name: badjeff
      url-base: https://github.com/badjeff
    - name: hsgw
      url-base: https://github.com/hsgw
    - name: caksoylar  # <-- led
      url-base: https://github.com/caksoylar
    - name: urob
      url-base: https://github.com/urob
    - name: mjmjm0101
      url-base: https://github.com/mjmjm0101

  projects:
    # ZMK 本体。公式の app/west.yml を取り込む
    # 検証用ブランチ: レイヤーロック (main で追加) を使うため v0.3 -> main
    - name: zmk
      remote: zmkfirmware
      revision: main
      import: app/west.yml

    # PMW3610 ドライバ（外部モジュール）
    - name: zmk-pmw3610-driver
      remote: badjeff
      revision: main
      # 置き場所を明示したい場合は path を指定（任意）
      # path: modules/zmk-pmw3610-driver

    # Sensor-rotation
    - name: zmk-feature-sensor_rotation
      remote: hsgw
      revision: main

    # LED
    - name: zmk-rgbled-widget  # <-- led
      remote: caksoylar
      revision: main

    - name: zmk-helpers
      remote: urob
      revision: main
    # urob leader-key モジュール (ZMK main 未収録機能をモジュール提供)
    - name: zmk-leader-key
      remote: urob
      revision: main
    - name: zmk-input-processor-scroll-inertia
      remote: mjmjm0101
      revision: f7dadefee453d555fe066d13a3de3bb60739b45e

  self:
    path: config
```
