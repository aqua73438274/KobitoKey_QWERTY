## config/west.yml
```yaml
manifest:
  remotes:
    - name: zmkfirmware
      url-base: https://github.com/zmkfirmware
    - name: badjeff
      url-base: https://github.com/badjeff
    - name: hsgw
      url-base: https://github.com/hsgw
    - name: caksoylar  # <-- led
      url-base: https://github.com/caksoylar  

  projects:
    # ZMK 本体。公式の app/west.yml を取り込む
    - name: zmk
      remote: zmkfirmware
      revision: v0.3
      import: app/west.yml

    # PMW3610 ドライバ（外部モジュール）
    - name: zmk-pmw3610-driver
      remote: badjeff
      revision: zmk-0.3
      # 置き場所を明示したい場合は path を指定（任意）
      # path: modules/zmk-pmw3610-driver
    
    # Sensor-rotation
    - name: zmk-feature-sensor_rotation
      remote: hsgw
      revision: main

    # LED
    - name: zmk-rgbled-widget  # <-- led
      remote: caksoylar
      revision: v0.3
      
    - name: zmk-helpers
      remote: urob
      revision: v0.3.0
    # urob leader-key モジュール (ZMK main 未収録機能をモジュール提供)
    # urob 推奨: revision は ZMK 本体 (上の zmk project) と揃える
    - name: zmk-leader-key
      remote: urob
      revision: v0.3.0
      
  self:
    path: config
```
